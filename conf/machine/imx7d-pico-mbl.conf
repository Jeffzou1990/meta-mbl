## conf/machine/imx7d-pico-mbl.conf
```bitbake
# Copyright (c) 2018 Arm Limited and Contributors. All rights reserved.
#
# SPDX-License-Identifier: MIT

#@TYPE: Machine
#@NAME: NXP IMX7D PICO-PI Development Board
#@DESCRIPTION: Machine configuration for the PICO PI board

MACHINEOVERRIDES =. "imx7d-pico:${MACHINE}:"
include conf/machine/imx7d-pico.conf

# ------------------------------------------------------------------------------
# non-MBL-specific (upstreamable) configuration
# ------------------------------------------------------------------------------

# ------------------------------------------------------------------------------
# MBL-specific (non-upstreamable) configuration
# ------------------------------------------------------------------------------

KERNEL_IMAGETYPE = "uImage"
KERNEL_DEVICETREE = "imx7d-pico.dtb"

UBOOT_ENTRYPOINT = "0x80800000"
UBOOT_DTB_LOADADDRESS = "0x83000000"

UBOOT_EXTLINUX = "0"
UBOOT_CONFIG = ""
UBOOT_MACHINE = "pico-pi-imx7d_defconfig"

WKS_FILES = "mbl-imx7d-pico.wks"

# Install initramfs into the boot partition
IMAGE_BOOT_FILES += "uImage-initramfs-imx7d-pico-mbl.bin"

# Combine initramfs image and kernel together to form a single image
# as it is recommended to bundle the initramfs image with the kernel image to avoid
# circular dependencies between the kernel recipe and the initramfs recipe should
# the initramfs image include kernel modules.
INITRAMFS_IMAGE_BUNDLE = "1"

# meta-mbl's linux-firmware bbappend (for imx7d-pico-mbl support) conflicts
# with meta-raspberrypi's linux-firmware bbappend (for rpi support). Make sure
# meta-raspberrypi's bbappend doesn't get used for imx7d-pico-mbl.
BBMASK += "/meta-raspberrypi/recipes-kernel/linux-firmware/"
BBMASK += "/meta-mbl/recipes-core/busybox/"

PACKAGEGROUP_MBL_PKGS_remove = " connman-client"
PACKAGEGROUP_MBL_PKGS_remove = " connman"
PACKAGEGROUP_MBL_PKGS_remove = " opkg"
PACKAGEGROUP_MBL_PKGS_remove = " optee-client"
PACKAGEGROUP_MBL_PKGS_remove = " optee-os"

IMAGE_BOOT_FILES += "boot.scr"

# Include the ATF recipe in the build
PREFERRED_PROVIDER_virtual/atf = "atf-pico"

do_image_wic[depends] += "virtual/bootloader:do_install"
do_image_wic[depends] += "mbl-boot-scr:do_deploy"
```

## meta-st-stm32mp-mbl/conf/layer.conf
```bitbake
# Copyright (c) 2019 Arm Limited and Contributors. All rights reserved.
#
# SPDX-License-Identifier: MIT
#
# mbed linux layer configuration file
BBPATH .= ":${LAYERDIR}"

# We have a recipes-* directories, add to BBFILES
BBFILES += "${LAYERDIR}/recipes*/*/*.bb ${LAYERDIR}/recipes*/*/*.bbappend"

BBFILE_COLLECTIONS += "stm-st-stm32mp"
BBFILE_PATTERN_st-stm32mp-mbl := "^${LAYERDIR}/"

LAYERSERIES_COMPAT_st-stm32mp-mbl = "warrior"
LAYERDEPENDS_st-stm32mp-mbl = "st-stm32mp"
LAYERDEPENDS_st-stm32mp-mbl += "meta-mbl-bsp-common"

#Inform bitbake for adding another location to search for licenses
# openembedded-core/meta/files/common-licenses
LICENSE_PATH += "${LAYERDIR}/files/licenses"
```

## meta-st-stm32mp-mbl/conf/machine/stm32mp1-dk2-mbl.conf
```bitbake
# Copyright (c) 2018 Arm Limited and Contributors. All rights reserved.
#
# SPDX-License-Identifier: MIT

#@TYPE: Machine
#@NAME: ST stm32mp157c-dk2 Development Board
#@DESCRIPTION: Machine configuration for the stm32mp1 with extra features enabled

MACHINEOVERRIDES =. "stm32mp1-dk2:${MACHINE}:"
include conf/machine/stm32mp1-dk2.conf

##do someting before??
require conf/include/mbl-default.conf

# ------------------------------------------------------------------------------
# non-MBL-specific (upstreamable) configuration
# ------------------------------------------------------------------------------

# Tell the meta-st-stm32mp1 layer to send Linux console output to the serial
# console
#SERIAL_CONSOLES = "115200;ttySTM0"  
#ENABLE_UART = "1"

# ------------------------------------------------------------------------------
# MBL-specific (non-upstreamable) configuration
# ------------------------------------------------------------------------------


##############################################################################
# KERNEL symbol definitions for virtual/kernel build configuration
#
# KERNEL_CLASSES
#   mbl-fitimage.bbclass is inherited into kernel.bbclass processing by
#   defining this symbol to include mbl-fitimage.
# KERNEL_IMAGETYPE
#   The kernel is packages in a FIT image by specifying "fitImage"
# KERNEL_DEVICETREE
#   Its unnecessary to change this symbol here as the required
#   "stm32mp1.dtb" value is specified in stm32mp1.conf (included above)
###############################################################################
KERNEL_CLASSES  = "mbl-fitimage"
KERNEL_IMAGETYPE = "fitImage"
# KERNEL_DEVICETREE = "bcm2710-rpi-3-b-plus.dtb bcm2710-rpi-3-b.dtb"

##############################################################################
# U-BOOT symbol definitions
#
# UBOOT_SIGN_ENABLE
#   This is used to enable u-boot verified boot. See uboot-sign.bbclass for
#   more information.
##############################################################################
UBOOT_CONFIG = ""
UBOOT_CONFIG[sd] = ""
UBOOT_MACHINE = "stm32mp15_basic_defconfig"
UBOOT_SUFFIX = "img"
UBOOT_BINARY = "u-boot.${UBOOT_SUFFIX}"
# 理论上因为mkimage要为zImage加上0x40字节的header，所以entry point = load address + 0x40
UBOOT_ENTRYPOINT = "0xC2000000"
UBOOT_DTB_LOADADDRESS = "0xC4000000"
UBOOT_IMAGE = "mbl-u-boot.bin"
UBOOT_SIGN_ENABLE = "1"

# Specify the ATF recipe to be used for this machine.
PREFERRED_PROVIDER_virtual/atf = "atf-${MACHINE}"

### Don't use any of the firmware-imx-* packages - they're covered by a EULA that
# prevents us doing binary releases
# ??MACHINE_EXTRA_RRECOMMENDS_remove = "firmware-imx-brcm"
#   MACHINE_EXTRA_RRECOMMENDS_remove = "firmware-imx-vpu-imx6d"
#   MACHINE_EXTRA_RRECOMMENDS_remove = "firmware-imx-vpu-imx6q"
#   MACHINE_EXTRA_RRECOMMENDS_remove = "bcm43430-nvram-config"
#   PACKAGE_EXCLUDE += "firmware-imx-vpu-imx6d"
### rpi3-extra-dtb-overlay package - add manually created dtb overlay
# ??MACHINE_EXTRA_RRECOMMENDS += " rpi3-extra-dtb-overlay "

###??? A valid u-boot.bin without any packed data is validated by earlier stage
###??? bootloader. So include u-boot-nodtb.bin here because u-boot.bin is packed
###??? with u-boot.dtb.
##???
##???IMAGE_BOOT_FILES += "bcm2835-bootfiles/* \
##???                 ${@make_dtb_boot_files(d)} \
##???                 ${@bb.utils.contains('RPI_USE_U_BOOT', '1', \
##???                    '${KERNEL_IMAGETYPE} u-boot-nodtb.bin;${SDIMG_KERNELIMAGE}', \
##???                    '${KERNEL_IMAGETYPE};${SDIMG_KERNELIMAGE}', d)} \
##???

# The name of the usbgadget ethernet interface to be used for debugging
MBL_DBG_IFNAME = "usbdbg0"
#OR ?? The name of the ethernet interface to be used for debugging
##? MBL_DBG_IFNAME = "eth1"

##############################################################################
# Partition layout config
##############################################################################
MBL_WKS_BOOTLOADER1_FILENAME = "bl2.bin.imx" ???
MBL_WKS_BOOTLOADER1_OFFSET_BANK1_KiB = "1"
MBL_WKS_BOOTLOADER1_IS_BL2 = "1"

MBL_WKS_BOOTLOADER2_IS_BL3 = "1"

# As reported by "mmc extcsd read /dev/mmcblk1"
MBL_FLASH_ERASE_BLOCK_SIZE_KiB = "6144"

# "blockdev --getsize64 /dev/mmcblk1" reports 7650410496B (= 7296MiB)
MBL_WKS_STORAGE_SIZE_MiB = "7296"
```

## meta-stm32mp-mbl/conf/layer.conf
```bitbake
# Copyright (c) 2019 Arm Limited and Contributors. All rights reserved.
#
# SPDX-License-Identifier: MIT
#
# mbed linux layer configuration file
BBPATH .= ":${LAYERDIR}"

# We have a recipes directory, add to BBFILES
BBFILES += "${LAYERDIR}/recipes*/*/*.bb ${LAYERDIR}/recipes*/*/*.bbappend"

BBFILE_COLLECTIONS += "st-stm32mp1-mbl"
BBFILE_PATTERN_st-stm32mp1-mbl := "^${LAYERDIR}/"

LAYERSERIES_COMPAT_st-stm32mp1-mbl = "warrior"
LAYERDEPENDS_st-stm32mp1-mbl = "st-stm32mp1"
LAYERDEPENDS_st-stm32mp1-mbl += "meta-mbl-bsp-common"

# This directory is for storing licenses which are not already included in
# openembedded-core/meta/files/common-licenses
LICENSE_PATH += "${LAYERDIR}/files/custom-licenses"
```

## meta-stm32mp1-mbl/conf/machine/stm32mp1-mbl.conf
```bitbake
# Copyright (c) 2018 Arm Limited and Contributors. All rights reserved.
#
# SPDX-License-Identifier: MIT

#@TYPE: Machine
#@NAME: ST stm32mp157c-dk2 Development Board
#@DESCRIPTION: Machine configuration for the stm32mp1 with extra features enabled

MACHINEOVERRIDES =. "stm32mp1:${MACHINE}:"
include conf/machine/stm32mp1.conf
require conf/include/mbl-default.conf

# ------------------------------------------------------------------------------
# non-MBL-specific (upstreamable) configuration
# ------------------------------------------------------------------------------

# Tell the meta-st-stm32mp1 layer to send Linux console output to the serial
# console

# SERIAL_CONSOLES = "115200;ttySTM0"
# ENABLE_UART = "1"

# ------------------------------------------------------------------------------
# MBL-specific (non-upstreamable) configuration
# ------------------------------------------------------------------------------


##############################################################################
# KERNEL symbol definitions for virtual/kernel build configuration
#
# KERNEL_CLASSES
#   mbl-fitimage.bbclass is inherited into kernel.bbclass processing by
#   defining this symbol to include mbl-fitimage.
# KERNEL_IMAGETYPE
#   The kernel is packages in a FIT image by specifying "fitImage"
# KERNEL_DEVICETREE
#   Its unnecessary to change this symbol here as the required
#   "imx7s-warp.dtb" value is specified in imx7s-warp.conf (included above)
###############################################################################
KERNEL_CLASSES  = "mbl-fitimage"
KERNEL_IMAGETYPE = "fitImage"

##############################################################################
# U-BOOT symbol definitions
#
# UBOOT_SIGN_ENABLE
#   This is used to enable u-boot verified boot. See uboot-sign.bbclass for
#   more information.
##############################################################################
UBOOT_MACHINE = "stm32mp1_bl33_defconfig"
UBOOT_IMAGE = "mbl-u-boot.bin"
UBOOT_ENTRYPOINT = "0x80800000" ??warp7
UBOOT_DTB_LOADADDRESS = "0x83000000" ??warp7

#UBOOT_ENTRYPOINT = "0x04000000"  rpi_3
#UBOOT_DTB_LOADADDRESS = "0x03000000"  rpi_3

UBOOT_IMAGE = "mbl-u-boot.bin"
UBOOT_SIGN_ENABLE = "1"

# Specify the ATF recipe to be used for this machine.
PREFERRED_PROVIDER_virtual/atf = "atf-${MACHINE}"


##############################################################################
# Partition layout config
##############################################################################
MBL_WKS_BOOTLOADER1_FILENAME = "bl2.bin.imx" ??
MBL_WKS_BOOTLOADER1_OFFSET_BANK1_KiB = "1"
MBL_WKS_BOOTLOADER1_IS_BL2 = "1"

MBL_WKS_BOOTLOADER2_IS_BL3 = "1"

MBL_WKS_BOOTLOADER_FS_SKIP = "0"


# As reported by "mmc extcsd read /dev/mmcblk1"
MBL_FLASH_ERASE_BLOCK_SIZE_KiB = "6144"

# We assume an 8GB or larger SD Card. 8GB =~ 7.4GiB. Round down to 7GiB to be
# on the safe side.
#
# Override this variable in local.conf if you use a different size of SD Card.
MBL_WKS_STORAGE_SIZE_MiB ?= "7168"
```
